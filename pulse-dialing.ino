/* Arduino Uno Sketch to *simulate* a telephone exchange (Vermittlungsstelle) for a *single telephone* using
 *  Pulse Dialing (US)/Loop-Disconnect Signalling (UK)/Decadic Signalling (AU)/Impuls Wahlverfahren (DE)
 *  (e.g., a rotary dial telephone)
 * 
 * Author: Chris Petrich, 2019-2021
 * Date: 3 Apr 2021
 * License: MIT
 * Source: https://github.com/cpetrich/
 * 
 * Scope: This project is intended to breath just enough life into an old rotary dial
 *        telephone to
 *        (a) make the phone ring, and
 *        (b) make it interesting for children to explore.
 *        
 *        As written it uses the German standard for state machine, dial tones and signals, timing, 
 *        and frequency of the bell (yes, phones used to ring differently in different countries).
 *        
 * Limitations: * This program does not manage connections between multiple phones.
 *              * Hook Flash is not implemented
 *              * Sound quality is poor due to hardware limitation of the Arduino Uno.
 *              * TODO: check if OCR1A needs to be adjusted for SAMPLE8 (i.e. SAMPLE64 not defined)
 * 
 * Hardware: Intended to be used with Arduino Uno and Silvertel Ag1170-5 Low Power Ringing SLIC
 *           - wire up Ag1170 as per datasheet
 *           - connect pin_FR to F/R, 
 *                     pin_RM to RM, and 
 *                     pin_SHK to SHK
 *           - connect audio out from Arduino Uno as follows
 *             (turns square wave into something more sine-like and sets volume):
 *
 *   ARDUINO                                ||          ||         Ag1170
 *   pin_AudioOut -----[100 kOhm]-----o-----||----------||-------- Vin
 *                                    |     ||          ||
 *                            100 nF ---      10 nF      100 nF
 *                                   ---
 *                                    |
 *                                   === GND
 * 
 * Revisions:
 * 
 * 2021/04/03: small adjustments (mostly comments) for GitHub publication
 * 2019/09/07: code completed
 * 
 */
 
#define SAMPLE64
// "kein Anschluss unter dieser Nummer"
// DAC delta signal run length-encoded
#ifdef SAMPLE64
// 64 kHz samples
const PROGMEM uint8_t sound_rl[] = {24,16,17,20,18,17,19,20,24,36,22,27,14,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2,19};
#else
#define SAMPLE8
// 8 kHz samples
const PROGMEM uint8_t sound_rl[] = {2,2,2,3,2,2,3,3,4,3,3,2,2,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4,4};
#endif

#define RING_BACK_TIME (25000)
#define RING_BACK_DELAY (3000)

int pin_LED = 13;

int pin_SHK = 5; // swich hook
int pin_FR = 3; // forward/reverse
int pin_RM = 4; // ringing mode
int pin_AudioOut = 11;

bool dial_tone = false;

#define F_tone_Hz (425)  // Frequenz fuer normale Zeichen
#define F_hinweis1_Hz (950)
#define F_hinweis2_Hz (1400)
#define F_hinweis3_Hz (1800)
#define HALF_PERIOD_RING_MS (20) // 25 Hz = 40 ms, i.e. half period is 20 ms

// 6.2.3.5 Das Telefon muss fuer mindestens 250 ms auflegen. Ansonsten kann das Netz durcheinander kommen.
// 6.1.13 in USS-Routine ist der Anschluss vermitlungstechnisch "abgeschaltet", d.h. das einzige Signal, das erkannt wird, ist Hoerer Auflegen.
//        Der Gassenbesetztton (GBsTon) wird fuer 60 s <= t <= 300 s gesendet, danach wird Strom zum Telefon auf Ruheniveau reduziert (1.8 mA oder 0).
//        Nachdem der GBsTon gesended wurde, muss der Hoerer fuer mindestens 2 s aufgelegt werden, um Normalzustand zu erreichen (Ruhezustand).

// 6.2.2.2 nach abheben des Hoerers hat das Telefon 120 ms Zeit, einzuschwingen, d.h. wir sollten SHK-Kontrolle fuer 120 ms unterbinden
// 6.2.3.4.1 Waehlzeichen koennen erst nach 200 ms nach Anliegen des Waehltones gegeben werden.
// 6.2.3.4.2 nach 60 s Waehlzeichen wird USS eingeleitet --> Gassenbesetztton

// 6.2.4.3 Der Waehlton wird vor Ende des ersten Waehlzeichens abgeschaltet
// 6.2.4.4 Waehlpause >4s fuehren zur USS-Routine

// 6.2.5 Kommunikationszustand ended mit Ruhezustand oder USS, je nachdem, welche Partei auflegt.

// 6.2.5.3 Gabelschaltsignale (Hook-Flash) (140-)170 ms < t < 310(-370) ms
// 6.2.6.2 Wenn keine Gabelschaltungsberechtgung vorliegt, dann wird Verbindungsabbau nach >85 ms auflegen erkannt

// 6.2.7.1 Anrufzustand am Ziel ist der Ruhezustand, Zentrale sendet Rufsignal (Wecker klingelt)
// 6.2.7.9 Netzt geht in USS-Routine wenn Anrufzustand > 60 s

// 6.2.8.3 Kommunikationszustand beginnttyp 250 ms nach dem Abheben des Hoerers.
// 6.2.8.5 Das Rufsignal wird innerhalb von 230 ms nach dem Abnehmen eingestellt. (Note: Modem has tighter requirements than that.)

// 7.2.2.2 Impuls = unterbrechung der Gleichstromschleife (d.h. auflegen), Pause = quasi Hoerer abgenommen.
// 7.2.2.4 Impulsdauer 52 ms < t < 71 ms, Pausen-dauer 32 ms < t < 46 ms, Gesamtlaenge 90 ms < t+t < 110 ms
//         Prellzeit < 3 ms
// 7.2.3 Zwischenwahlzeit, d.h. Zeit zwischen Ziffern is >= 680 ms. (Nach 4s Uebergang zur USS-Routine).

// 8.8 Der Hinweiston is leiser als die normalen Signaltoene

volatile unsigned long clk_previous_SHK_low_ms = 0; // length of last LOW signal (valid if we're currently HIGH)
volatile unsigned long clk_previous_SHK_high_ms = 0; // length of last HIGH signal (valid if we're currently LOW)
volatile unsigned long clk_current_SHK_low_ms = 0; 
volatile unsigned long clk_current_SHK_high_ms = 0;
volatile byte clk_SHK_status = 0; // 0: low, 1: high, 2: low -> high, 3: high -> low
volatile unsigned long clk_custom_counter = 0;
volatile unsigned long clk_dial_counter = 0;

enum class Zustand {
  RuheZ, WahlZ, AnrufZ, KommunikationsZ, USS
};

enum class Signal {
  Aus, Waehlton, Freiton, Besetztton, Gassenbesetztton, Hinweiston_KeinAnschluss, Rufsignal
  // nicht implementiert: 8.2 Sonderwaehlton wenn System Steuerzeichen ueber die Wahlscheibe erwartet -- initiiert durch Hook Flash
};

volatile uint16_t rl_next_run = 0;
volatile int8_t rl_counter = 0;
volatile byte rl_play_sound = 0;

void play_delta_rl() {
  if (rl_counter <= 0) {
    rl_counter = pgm_read_byte_near(sound_rl + rl_next_run);
    digitalWrite(pin_AudioOut, !digitalRead(pin_AudioOut));
    rl_next_run ++;
    if (rl_next_run == sizeof(sound_rl)) {
      rl_next_run = 0;
      rl_play_sound = 0;
    }
  }
  rl_counter --;  
}

Signal sig_status = Signal::Aus;
volatile int sig_state; // meaning depends on signal
volatile int sig_counter; // meaning depends on signal and sig_state
volatile int sig_counter2; // meaning depends on signal and sig_state

void init_signal(Signal sig) {
  rl_play_sound = 0; // stop playing whatever sampled sound we play
  if (Signal::Aus == sig) {    
    sig_status = Signal::Aus;
    digitalWrite(pin_FR, HIGH);
    digitalWrite(pin_RM, LOW);
    noTone(pin_AudioOut);
  } else
  if (Signal::Waehlton == sig) {
    sig_status = Signal::Aus;
    digitalWrite(pin_FR, HIGH);
    digitalWrite(pin_RM, LOW);
    tone(pin_AudioOut, F_tone_Hz);
    sig_status = Signal::Waehlton;    
  }
  if (Signal::Rufsignal == sig) {
    sig_status = Signal::Aus;
    noTone(pin_AudioOut);
    sig_state = 1; // 500 ms Klingel
    sig_counter = 500;
    sig_counter2 = HALF_PERIOD_RING_MS;
    digitalWrite(pin_RM, HIGH);
    digitalWrite(pin_FR, LOW);
    sig_status = Signal::Rufsignal;
  }
  if (Signal::Freiton == sig) { // Verbindung ist aufgebaut
    sig_status = Signal::Aus;
    digitalWrite(pin_FR, HIGH);
    digitalWrite(pin_RM, LOW);
    
    tone(pin_AudioOut, F_tone_Hz);    
    sig_state = 1;
    sig_counter = 500; // 450 to 1100 ms    
    sig_status = Signal::Freiton;
  }
  if (Signal::Besetztton == sig) {
    sig_status = Signal::Aus;
    digitalWrite(pin_FR, HIGH);
    digitalWrite(pin_RM, LOW);
    
    tone(pin_AudioOut, F_tone_Hz);    
    sig_state = 1;
    sig_counter = 480; // 480 ms +-10%
    sig_status = Signal::Besetztton;
  }
  if (Signal::Gassenbesetztton == sig) {
    sig_status = Signal::Aus;
    digitalWrite(pin_FR, HIGH);
    digitalWrite(pin_RM, LOW);
    
    tone(pin_AudioOut, F_tone_Hz);    
    sig_state = 1;
    sig_counter = 240; // 240 ms +-10%
    sig_status = Signal::Gassenbesetztton;
  }
  if (Signal::Hinweiston_KeinAnschluss == sig) {    
    sig_status = Signal::Aus;
    digitalWrite(pin_FR, HIGH);
    digitalWrite(pin_RM, LOW);
    
    tone(pin_AudioOut, F_hinweis1_Hz);
    sig_state = 1;
    sig_counter = 330; // 330 ms +-10%
    sig_status = Signal::Hinweiston_KeinAnschluss;
  }
}

void process_signal(Signal sig, char dt) {
  // this fcn is called in 1ms intervals
  if (Signal::Aus == sig) {
    return;    
  } else
  if (Signal::Waehlton == sig) {
    return;
  } else
  if (Signal::Rufsignal == sig) {
    sig_counter -= dt;
    sig_counter2 -= dt;
    if (sig_counter > 0) {
      // let the bell ring
      if (sig_counter2 <= 0) {
        digitalWrite(pin_FR, !digitalRead(pin_FR));
        sig_counter2 = HALF_PERIOD_RING_MS;
      }
    } else {
      if (1 == sig_state) {
        digitalWrite(pin_FR, HIGH);
        digitalWrite(pin_RM, LOW);
        sig_counter = 1000; // anything from 0 to 5000 ms break
        sig_counter2 = 2*sig_counter; // disable ringing pulses
        sig_state = 2;
      } else
      if (2 == sig_state) {
        digitalWrite(pin_RM, HIGH);
        digitalWrite(pin_FR, LOW);
        sig_counter = 1000; // always 1000 ms ring
        sig_counter2 = HALF_PERIOD_RING_MS;
        sig_state = 3;
      } else
      if (3 == sig_state) {
        digitalWrite(pin_FR, HIGH);
        digitalWrite(pin_RM, LOW);
        sig_counter = 5000; // always 5000 ms break
        sig_counter2 = 2*sig_counter; // disable ringing pulses
        sig_state = 2;
      }
    }
  } else
  if (Signal::Freiton == sig) {
    sig_counter -= dt;
    if (sig_counter <= 0) {
      if (1 == sig_state) {
        noTone(pin_AudioOut);
        sig_counter = 1000; // 0 to 4400 ms
        sig_state = 2;        
      } else
      if (2 == sig_state) {
        tone(pin_AudioOut, F_tone_Hz);
        sig_counter = 1000; // 1000 ms +-100 ms
        sig_state = 3;
      } else
      if (3 == sig_state) {
        noTone(pin_AudioOut);
        sig_counter = 4000; // 4000 +- 400 ms
        sig_state = 2;
      }
    } // else do nothing
  }
  if (Signal::Besetztton == sig) {
    sig_counter -= dt;
    if (sig_counter <= 0) {
      if (1 == sig_state) {
        noTone(pin_AudioOut);
        sig_counter = 480; // 480 +- 48 ms
        sig_state = 2;
      } else      
      if (2 == sig_state) {
        tone(pin_AudioOut, F_tone_Hz);
        sig_counter = 480; // 480 +- 48 ms
        sig_state = 1;
      }
    }
  }
  if (Signal::Gassenbesetztton == sig) {
    sig_counter -= dt;
    if (sig_counter <= 0) {
      if (1 == sig_state) {
        noTone(pin_AudioOut);
        sig_counter = 240; // 240 +- 24 ms
        sig_state = 2;
      } else      
      if (2 == sig_state) {
        tone(pin_AudioOut, F_tone_Hz);
        sig_counter = 240; // 240 +- 24 ms
        sig_state = 1;
      }
    }    
  }
  if (Signal::Hinweiston_KeinAnschluss == sig) {
    sig_counter -= dt;
    if (sig_counter <= 0) {
      if (1 == sig_state) {
        tone(pin_AudioOut, F_hinweis2_Hz);
        sig_counter = 330; // 330 ms +- 10%
        sig_state = 2;
      } else
      if (2 == sig_state) {
        tone(pin_AudioOut, F_hinweis3_Hz);
        sig_counter = 330; // 330 ms +- 10%
        sig_state = 3;
      } else
      if (3 == sig_state) {
        // kein Anschluss text -- oder Pause
        noTone(pin_AudioOut);
        rl_next_run = 0;
        rl_counter = 0;
        rl_play_sound = 1;
        sig_counter = 1;
        sig_state = 4;
      } else
      if (4 == sig_state) {        
        if (0 == rl_play_sound)
          sig_state = 5;
        else          
          sig_counter = 1;        
      } else
      if (5 == sig_state) {
        tone(pin_AudioOut, F_hinweis1_Hz);
        sig_counter = 330; // 330 ms +- 10%
        sig_state = 1;
      }
    }    
  }
}


ISR(TIMER1_COMPA_vect) {
  static int sub_ms = 0;
  static unsigned long clk_1ms = 0; // 32 bit counter roll-over every 49 days -- we could reset this on a successful SHK level change
  static byte debounce_counter = 0; // counts down from to 10, only
  static unsigned long last_low_start = 0; // clock value when we last started clk_SHK_status == 0
  static unsigned long last_high_start = 0; // clock value when we last started clk_SHK_status == 1

  
  sub_ms += 1;
  if (rl_play_sound) play_delta_rl();
  #ifdef SAMPLE64
  if (sub_ms < 64) return;
  #else
  if (sub_ms < 8) return;
  #endif
  sub_ms = 0;
  

#define DT (1)
  clk_custom_counter += DT;
  clk_dial_counter += DT;
  
  clk_1ms += DT;  
  
  bool SHK_high = (HIGH == digitalRead(pin_SHK));
  bool SHK_low = !SHK_high;

  if (SHK_low && (0 == clk_SHK_status)) { // low
    clk_current_SHK_low_ms = clk_1ms - last_low_start;
  } else
  if (SHK_high && (1 == clk_SHK_status)) { // high
    clk_current_SHK_high_ms = clk_1ms - last_high_start;
  } else
  if (SHK_high && (0 == clk_SHK_status)) { // was: low
    // initiate debounce
    clk_SHK_status = 2; // low->high?
    debounce_counter = 10;
    clk_current_SHK_low_ms = clk_1ms - last_low_start;
  } else
  if (2 == clk_SHK_status) { // was: low->high transition
    clk_current_SHK_low_ms = clk_1ms - last_low_start;
    debounce_counter -= 1;
    if (0 == debounce_counter) {
      if (SHK_high) {
        clk_SHK_status = 1; // successful transition from low to high
        last_high_start = clk_1ms;
        clk_previous_SHK_low_ms = clk_1ms - last_low_start;
        clk_current_SHK_high_ms = 0;
      } else
        clk_SHK_status = 0; // no transition from low to high, staying at low
    } // else: do nothing else
  } else
  if (SHK_low && (1 == clk_SHK_status)) { // was: high, now maybe low
    clk_current_SHK_high_ms = clk_1ms - last_high_start;
    clk_SHK_status = 3; // high->low?
    debounce_counter = 10;
  } else
  if (clk_SHK_status == 3) { // was: high->low transition
    clk_current_SHK_high_ms = clk_1ms - last_high_start;
    debounce_counter -= 1;
    if (debounce_counter == 0) {
      if (SHK_low) {
        clk_SHK_status = 0; // transition from low to high
        last_low_start = clk_1ms;
        clk_previous_SHK_high_ms = clk_1ms - last_high_start;
        clk_current_SHK_low_ms = 0;
      } else
        clk_SHK_status = 1; // no transition from high to low, staying high      
    } // else: do nothing else
  }

  process_signal(sig_status, DT);
  
}

void init_timer1() {  
  // 16 bit write: high->low --> can simply assign an unsigned int to register in C
  // 16 bit read: low->high

  // we assume here that the global system prescaler is set to 1.
  
  // disable IRQ
  byte sreg = SREG;
  cli();  
  // clear power reduction bit to 0 to enable Timer1
  PRR &= (0xff ^ _BV(PRTIM1));
    
  // disconnect timer form port
  TCCR1A &= 0x0f;

  // CTC: clear timer on compare match: (WGM1[0:3] = 0x04)
  // counter set to 0x0000 when TCNT1 matches OCR1A
  // set to CTC mode on OCR1A, TOV1 flag set on MAX
  TCCR1A &= (0xff ^ _BV(WGM10) ^ _BV(WGM11));
  // same as TCCR1A &= 0x0c;
  
  TCCR1B &= (0xff - _BV(WGM13));
  TCCR1B |= _BV(WGM12);

  // clock select: 
  TCCR1B &= (0xff ^ _BV(CS10) ^ _BV(CS11) ^ _BV(CS12)); // remove clock source to stop timer
  {
    // set current timer value
    TCNT1 = 0x0000;
  }  
  // prescaler of clk_IO 1:1, 2:8, 3:64, 4:256, 5:1024
  #ifdef SAMPLE64
  TCCR1B |= _BV(CS10); // divide by 1 for 64 kHz
  #else
  TCCR1B |= _BV(CS11); // divide by 8 for 8 kHz
  #endif
      
  // set TOP value to count to, counter is reset to 0 once we reach this value
  // OCR1A = (16,000,000 / prescaler) / output_frequency
  // output frequency = 1000 Hz (1 ms) --> 250 (0xFA) for prescaler==64
  OCR1A = 0x00fa;
  
  // enable interrupt on output compare, i.e. OCFIA flag
  TIMSK1 &= (0xff ^ _BV(ICIE1) ^ _BV(OCIE1B) ^ _BV(TOIE1));
  TIMSK1 |= _BV(OCIE1A);

  // generate interrupt on OCF1A flag set --> clear flag
  TIFR1 &= 0xff ^ _BV(OCF1A);

  // restore IRQ state to what it was when we entered the routine
  SREG = sreg;
}

// NOTE: THESE ARE COPIED INTO MEMORY. TODO: KEEP IN FLASH
// known numbers should be stored in trees, so we can emit an error as soon as we dial a digit that is not a child.
const char own_number[] = "45"; // always busy
const char callback_number[] = "0"; // busy, then ringing back
const char *known_numbers[]={"14","22","23","303","42","6",NULL}; // will be either busy or indicate ringing (randomly chosen)
const char *dead_leaves[]={"10","11","12","13","15","16","17","18","19",
                           "31","32","33","34","35","36","37","38","39",
                           "40","41","43","44","46","47","48","49",
                           "20","21","24","25","26","27","28","29",
                           "5","7","8","9",NULL}; // will be 'kein Anschluss unter dieser Nummer'

unsigned int max_strlen(const char **db) {
  unsigned int maxi = 0;
  unsigned int i = 0;
  while (db[i]) {  
    if (strlen(db[i]) > maxi)
      maxi = strlen(db[i]);
    i ++;
  }
  return maxi;
}

bool number_contained(const char **db, char *number) {  
  int i = 0;
  while (db[i]) {  
    if (0 == strcmp(number, db[i])) return true;
    i ++;
  }
  return false;
}

void setup() {    
  rl_next_run = 0;
  rl_counter = 0;
  rl_play_sound = 0;  
  pinMode(pin_AudioOut, OUTPUT);
  //init_timer1();
  //sei();
  //return;
  pinMode(pin_SHK, INPUT);
  pinMode(pin_LED, OUTPUT);
  digitalWrite(pin_FR, HIGH);
  digitalWrite(pin_RM, LOW);
  pinMode(pin_FR, OUTPUT);
  pinMode(pin_RM, OUTPUT);
  noTone(pin_AudioOut);
  clk_custom_counter = 0;
  clk_dial_counter = 0;
  init_timer1();
  sei();
  
  Serial.begin(115200);
}

void init_signal_if_new(Signal sig) {
  if (sig != sig_status) {
    init_signal(Signal::Aus);    
    init_signal(sig);
  }
}

void loop() {  

// bool SHK_high = (HIGH == digitalRead(pin_SHK));
// Anlegen eines Gleichstromkreises an den Adern a und b des NTA mit so niedrigem Widerstand, dass der AnWAs belegt wird: Schleife schließen (Schleifenschluss).
// > 1 MOhm: Gleichstromkreis der Endeinrichtung offen
// Ruhezustand: Gleichstromschleife ist offen
// Der Impuls ist eine Unterbrechung der Gleichstromschleife (SHK=HIGH), die Pause ist eine Schließung der Gleichstromschleife (SHK=LOW).

// 7.2.2.2 Impuls = unterbrechung der Gleichstromschleife (d.h. auflegen) LOW, Pause = quasi Hoerer abgenommen HIGH.
// 7.2.2.4 Impulsdauer 52 ms < t < 71 ms, Pausen-dauer 32 ms < t < 46 ms, Gesamtlaenge 90 ms < t+t < 110 ms

// BT Standard BT SIN 351, Section 4.2: loop disconnect signalling: digits at a rate of 100 ms+-10 ms, break period is 67 ms+-5, inter-digit pause between 240 and 920 ms, break pulse > 15 ms, make pulse > 5 ms

// Make/Break Ratio for Pulse Dialing:
// AT&P0 - North America: Selects 39%-61% make/break ratio at 10 pulses per second
// AT&P1 - Europe: Selects 33%-67% make/break ratio at 10 pulses per second

// SKy analogue network interface:
// The break period has to be in the range20 ms < t < 103 ms and the make period has to be in the range 20 ms < t < 200 ms. 
//  The inter-digit timeout is 240 ms. The maximum dialing pulse rate is 10 +-1

// Australian standard AS/CA S002:2010, Section 5.5.1.8 Decadic Signalling
//  Break pulse: line current <2.8 mA  -- 60 to 70 ms
//  Make pulse: line current >12 mA -- 30 to 40 ms
//  signal bounce 0.5 ms
//  Inter-digit period separating pulse trains shall be 750 ms to 3 s, with 800 ms recommended.

// AT&T: 8 to 11 dial pulses per second (pg 112/3)
// pg 22: Break: pulse contacts are open, Make: pulse contacts are closed
//  percent-break: break vs total Nominally 61%, 58-64%
// AT&T notes on distnace dialling, 1968
// (72) percent-break Nominally 61%, 58-64%   (older phones: 59.5-67%)
// (73) Bell accepts 300 ms inter-digit separation but produces at least 500 ms, with 600 ms typ minimum.

  const int dial_number_length_max = 15+3; // 15 for the number, 3 for external access
  const int dial_break_length_min = 20; // We use lenient 20 ms to work with absolutely any phone.
  const int dial_break_length_max = 90; // The max specified is 72 ms, so we'll stay above that.
  const int dial_pulse_length_min = 90; // pulse == break + make. 11 pulses per second are within specs (i.e., 90ms), so use a little less.
  const int dial_pulse_train_separation_min = 250; // inter-digit period is typically 800 ms, but at least 200-300 ms due to dial rotation alone
  const int dial_timeout = 4100; // ms (4 s in German standard)
  const int hangup_detect_length_min = 310; // this value is actually 2000 ms after USS routine but we use the normal period in that case also
  const int pickup_detect_length_min = 200; // at least 120 ms due to debounce due to voltage/current adjustment in the phone
  const int32_t pickup_timeout = 61000; // inactivity, calling, busy signal, ...  
  const int32_t USS_timeout = 300000; // after 5 minutes, shut-off the line. Note that this includes the time after which the USS started.
  
  static char dialled_number[dial_number_length_max+2]; // intl phone number plus local dialling convention plus 1 digit to detect excessive length plus 1 for \0
  static int state = -1;
  static int digit;
  static bool pulse_processed;
  static int32_t ring_back_ms = 0;

  if (0) {
    // to check timing
    Serial.print(clk_current_SHK_high_ms); // abgehoben
    Serial.write(' ');
    Serial.print(clk_previous_SHK_high_ms);
    Serial.write(' ');    
    Serial.print(clk_previous_SHK_low_ms);
    Serial.write(' ');
    Serial.println(clk_current_SHK_low_ms); // aufgelegt    
  }

  if (-1 == state) {
    // first run, only
    init_signal_if_new(Signal::Aus);
    state = 0;
    clk_custom_counter = 0;
    *dialled_number = 0;
    digit = -1;
    pulse_processed = true;
    Serial.println("Welcome");
    Serial.print("Phone numbers: ");
    Serial.print(own_number);
    Serial.print(", ");
    int i;
    while (known_numbers[i]) {
      Serial.print(known_numbers[i]);
      if (known_numbers[i+1])
        Serial.print(", ");
      i++;
    }
    Serial.println(".");
    Serial.print("Callback number: ");
    Serial.print(callback_number);
    Serial.println(".");
  }  

  // read clk_SHK_status only one per loop
  // so the following block uses a consistent state
  // note that clk_current_SHK_high_ms and clk_previous_SHK_high_ms are defined in a way that a
  //   single state change won't matter. And there won't be more than one per loop since we have 10 ms debounce.

  // we use for dialling these:
  bool SHK_high = (1 == (clk_SHK_status & 1));  // Kreis geschlossen, d.h. Pause
  bool SHK_low = !SHK_high;   // Kreis offen, d.h. Impuls
  // and otherwise those:
  bool on_hook = !SHK_high;
  bool off_hook = SHK_high;
  
  if (on_hook && (clk_current_SHK_low_ms >= hangup_detect_length_min) && (0 != state) && (8 != state)) {
    // user hung up
    if (state == 2) Serial.println();
    Serial.println("Hang Up");
    init_signal_if_new(Signal::Aus);
    state = 0;    
    //clk_custom_counter = 0;    
  }

  if (on_hook && (0 == state) && (clk_current_SHK_low_ms > RING_BACK_DELAY) && (ring_back_ms > 0)) {
    if (state == 2) Serial.println();
    Serial.println("Ringing");
    init_signal_if_new(Signal::Rufsignal);
    state = 8;    
  }

  if (on_hook && (8 == state) && (clk_current_SHK_low_ms > RING_BACK_DELAY+ ring_back_ms)) {
    if (state == 2) Serial.println();
    Serial.println("Stop Ringing");
    init_signal_if_new(Signal::Aus);
    ring_back_ms = 0;
    state = 0;
  }

  if (off_hook && (clk_current_SHK_high_ms >= pickup_detect_length_min) && ((0 == state) || (8 == state))) {
    if (state == 2) Serial.println();    
    Serial.println("Pick Up");
    if (state == 8) {
      Serial.println("Interrupt Ringing");
      ring_back_ms = 0;
    }
    // user picks up the phone
    init_signal_if_new(Signal::Waehlton);
    state = 1;
    *dialled_number = 0;
    // no valid digit
    digit = -1;
    // wait for a new pulse -- makes sure we're not double-counting pulses, regardless of timeout setting for pulse train
    pulse_processed = true;
  }

  if (SHK_low && (clk_current_SHK_low_ms >= dial_break_length_min) && pulse_processed && ((1 == state) || (2 == state))) {
    // a pulse that may be a dial pulse
    pulse_processed = false;
  }

  if (SHK_high && !pulse_processed && (clk_previous_SHK_low_ms > dial_break_length_max)) {
    // previous pulse was too long, i.e. it was not a dialling pulse after all.
    pulse_processed = true; // --> we ignore that pulse for dialling purposes.
  }
  
  if (SHK_high && (clk_previous_SHK_low_ms >= dial_break_length_min) && (clk_previous_SHK_low_ms <= dial_break_length_max)
      && (clk_previous_SHK_low_ms + clk_current_SHK_high_ms >= dial_pulse_length_min) && !pulse_processed && ((state == 1) || (state == 2))) {        
        // received dial pulse
        if (state == 1) {
          if (state == 2) Serial.println();
          Serial.print("Dialling: ");
          init_signal_if_new(Signal::Aus);
          state = 2;
        }
        if (digit == -1)
          digit = 1;
        else       
          digit ++;
        pulse_processed = true;
      }
    
  if (SHK_high && (clk_current_SHK_high_ms >= dial_pulse_train_separation_min) && (digit != -1) && (2 == state)) {
    // note that pulse_processed is always TRUE at this point since the previous 2 blocks would have caught the pulse
    // pulse train is done
    if ((digit >= 1) && (digit <= 10)) {
      const int old_term = strlen(dialled_number);
      dialled_number[old_term+1] = 0; // new string terminator
      dialled_number[old_term] = '0' + (digit % 10);
      
      Serial.print(digit % 10);
    } else {
      if (state == 2) Serial.println();
      Serial.println("Error, pulse count: ");
      Serial.println(digit);
    }
    digit = -1;
    // wait for a new pulse -- makes sure we're not double-counting pulses, regardless of timeout setting for pulse train

    // just added a digit, test immediately if number is too long and enter USS-Routine if it is
    if ((2 == state) && (strlen(dialled_number) > dial_number_length_max)) {
      // Note: it would be sufficient to test this only after digits are added
      if (state == 2) Serial.println();
      Serial.println("Unnoetiger Schleifenschluss");
      state = 3;
      init_signal_if_new(Signal::Gassenbesetztton);
    }
    if (off_hook && (state == 2) && (0 == strcmp(callback_number, dialled_number))) {
      if (state == 2) Serial.println();        
      Serial.println("Dialled Callback Number");
      ring_back_ms = RING_BACK_TIME;
      state = 5;
      init_signal_if_new(Signal::Besetztton);      
    }
    if (off_hook && (state == 2) && (0 == strcmp(own_number, dialled_number))) {
      if (state == 2) Serial.println();        
        Serial.print("Line busy at ");
        Serial.print(dialled_number);
        Serial.println(" (own number)");
                
        state = 5;
        init_signal_if_new(Signal::Besetztton);
    }
    
    if (off_hook && (state == 2) && number_contained(known_numbers, dialled_number)) {
      // successfully dialled a known number. Choose randomly between line busy and ringing.
      long rnd = random(3);
      if (rnd == 0) {
        if (state == 2) Serial.println();
        Serial.print("Line busy at ");
        Serial.println(dialled_number);
        
        state = 5;
        init_signal_if_new(Signal::Besetztton);
      } else {
        if (state == 2) Serial.println();
        Serial.print("Connected to ");
        Serial.print(dialled_number);
        Serial.println(", waiting for party to pick up.");
        
        state = 4;
        init_signal_if_new(Signal::Freiton);
      }      
    }
  
  if (off_hook && (state == 2) && 
      ((strlen(dialled_number)>=max_strlen(known_numbers)) || (number_contained(dead_leaves, dialled_number)))) {
    // known dead leaves or long number not caught otherwise
    if (state == 2) Serial.println();
    Serial.print("Kein Anschluss unter dieser Nummer: ");
    Serial.println(dialled_number);

    state = 6;
    init_signal_if_new(Signal::Hinweiston_KeinAnschluss);
    }
  }
  
  if (off_hook && (clk_current_SHK_high_ms >= dial_timeout) && (2 == state)) {    
    if (state == 2) Serial.println();
    Serial.println("Unnoetiger Schleifenschluss");
    // USS
    state = 3;
    init_signal_if_new(Signal::Gassenbesetztton);
  }

  if (off_hook && (clk_current_SHK_high_ms > pickup_timeout) && 
      ((1 == state) || (4 == state) || (5 == state) || (6 == state))) {
    if (state == 2) Serial.println();
    Serial.println("Unnoetiger Schleifenschluss");
    // USS
    state = 3;
    init_signal_if_new(Signal::Gassenbesetztton);
  }

  if (off_hook && (clk_current_SHK_high_ms > USS_timeout) && (3 == state)) {
    if (state == 2) Serial.println();
    Serial.println("Shutting Off Line");
    init_signal_if_new(Signal::Aus);
    state = 7;
  }

}
